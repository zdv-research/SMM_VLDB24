## implementations/mmap_thread_private/linux-5.15.12/Kconfig
```kconfig
# SPDX-License-Identifier: GPL-2.0
#
# For a description of the syntax of this configuration file,
# see Documentation/kbuild/kconfig-language.rst.
#
mainmenu "Linux/$(ARCH) $(KERNELVERSION) Kernel Configuration"

source "scripts/Kconfig.include"

source "init/Kconfig"

source "kernel/Kconfig.freezer"

source "fs/Kconfig.binfmt"

source "mm/Kconfig"

source "net/Kconfig"

source "drivers/Kconfig"

source "fs/Kconfig"

source "security/Kconfig"

source "crypto/Kconfig"

source "lib/Kconfig"

source "lib/Kconfig.debug"

source "Documentation/Kconfig"

# config USE_TPMM
#    bool "USE_TPMM"
#    default y

# config USE_TPMM_SEC_AND_KSWAPD
#    bool "USE_TPMM_SEC_AND_KSWAPD"
#    default y

# .tpmmmun
config USE_TPMM_MUNMAP_TLB_SKIP
   bool "USE_TPMM_MUNMAP_TLB_SKIP"
   default y

# .faultmark
config USE_TPMM_PAGE_FAULT_MARK
   bool "USE_TPMM_PAGE_FAULT_MARK"
   default y

# .allocflush
config USE_TPMM_ALLOC_FLUSH_CHECK
   bool "USE_TPMM_ALLOC_FLUSH_CHECK"
   default y

# .kswapd
config USE_TPMM_KSWAPD_TLB_SKIP
   bool "USE_TPMM_KSWAPD_TLB_SKIP"
   default y

# .ktb
config USE_TPMM_KSWAPDTLB_BYPASS
   bool "USE_TPMM_KSWAPDTLB_BYPASS"
   default y

# .pmem
config USE_TPMM_PMEM
   bool "USE_TPMM_PMEM"
   default y

config USE_TPMM_FINE_CPUBITMASKS
   bool "USE_TPMM_FINE_CPUBITMASKS"
   default y

# .ownflush
config USE_TPMM_MUNMAP_OWN_FLUSH
   bool "USE_TPMM_MUNMAP_OWN_FLUSH"
   default y

config TPMM_DEBUG_ENABLED
   bool "TPMM_DEBUG_ENABLED"
   default y
```
